## BUILD/conf/bblayers.conf
```bitbake
# POKY_BBLAYERS_CONF_VERSION is increased each time build/conf/bblayers.conf
# changes incompatibly
POKY_BBLAYERS_CONF_VERSION = "2"

BBPATH = "${TOPDIR}"
BBFILES ?= ""

BBLAYERS ?= " \
  /home/selengalp/yocto-custom-os/poky/meta \
  /home/selengalp/yocto-custom-os/poky/meta-poky \
  /home/selengalp/yocto-custom-os/poky/meta-yocto-bsp \
  /home/selengalp/yocto-custom-os/meta-raspberrypi \
  /home/selengalp/yocto-custom-os/meta-openembedded/meta-oe \
  /home/selengalp/yocto-custom-os/meta-openembedded/meta-multimedia \
  /home/selengalp/yocto-custom-os/meta-openembedded/meta-networking \
  /home/selengalp/yocto-custom-os/meta-openembedded/meta-python \
  /home/selengalp/yocto-custom-os/meta-openembedded/meta-filesystems \
  /home/selengalp/yocto-custom-os/meta-virtualization \
  /home/selengalp/yocto-custom-os/meta-selengalp \
  "
```

## BUILD/conf/local.conf
```bitbake
# CONF_VERSION is increased each time build/conf/ changes incompatibly and is used to
# track the version of this file when it was generated. This can safely be ignored if
# this doesn't mean anything to you.
CONF_VERSION = "2"

# We need to set the default machine ourselves
MACHINE = "raspberrypi4-64"

# We need to set the default distro ourselves
DISTRO = "poky"

# We need to set package type ourselves
PACKAGE_CLASSES = "package_rpm"

# We need to set the default distro features ourselves
DISTRO_FEATURES:append = " virtualization systemd"

# We need to set the default init manager ourselves
VIRTUAL-RUNTIME_init_manager = "systemd"
DISTRO_FEATURES_BACKFILL_CONSIDERED = "sysvinit"

# Move it to the image reciper after testing
# Make sure this cgroups stuff is configured in the kernel already.
# Otherwise made a bsp bbappend layer and add it there.
CMDLINE:append = " cgroup_enable=memory cgroup_memory=1"
```
